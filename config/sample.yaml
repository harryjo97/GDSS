## config/sample.yaml
```yaml
data:
  data: ZINC250k
  dir: './data'

ckpt: gdss_zinc250k

sampler:
  predictor: Reverse
  corrector: Langevin
  snr: 0.2
  scale_eps: 0.9
  n_steps: 1

sample:
  use_ema: False
  noise_removal: True
  probability_flow: False
  eps: 1.0e-4
  seed: 42
```
